## targets/cubieboard/conf/bblayers.conf
```bitbake
LCONF_VERSION = "6"

OPDIR := "${OETREE}"

BBFILES = ""

BBLAYERS = " \
    ${OETREE}/poky/meta \
    ${OETREE}/poky/meta-yocto \
    ${OETREE}/poky/meta-yocto-bsp \
    ${OETREE}/layers/meta-oe/meta-oe \
    ${OETREE}/layers/meta-oe/meta-systemd \
    ${OETREE}/layers/meta-oe/meta-networking \
    ${OETREE}/layers/meta-oe/meta-webserver \
    ${OETREE}/layers/meta-sunxi \
    ${OETREE}/layers/meta-mtrx \
    "

BBMASK ?= "${OETREE}/layers/meta-oe/meta-systemd/meta-(efl|gnome|multimedia)/"
```

## targets/cubieboard/conf/local.conf
```bitbake
CONF_VERSION = "1"

DISTRO = "poky"
MACHINE = "cubieboard"
RELEASE_TYPE = "test"

IMAGE_FSTYPES = "tar.bz2 "
#IMAGE_CLASSES += "sdcard_image"

PREFERRED_PROVIDER_virtual/kernel = "linux-sunxi"
PREFERRED_VERSION_linux-libc-headers = "3.0.8"
PREFERRED_VERSION_linux ?= "3.0"
PREFERRED_PROVIDER_udev = "systemd"

ROOTFSTYPE_cubieboard = "ext4"

OE_ALLOW_INSECURE_DOWNLOADS="0"

# saves disk space
INHERIT += " rm_work "

# Set TMPDIR instead of defaulting it to $pwd/tmp
TMPDIR = "${OETREE}/${DISTRO}-${RELEASE_TYPE}-build"
SSTATE_DIR = "${TMPDIR}/sstate-cache"

# Make use of SMP and fast disks
PARALLEL_MAKE = "-j4"
BB_NUMBER_THREADS = "3"

IMAGE_INSTALL_append = " u-boot-sunxi sunxi-boards "
```
